## kernel/Kconfig
```kconfig
menu "KinSU"

config KSU
	tristate "KinSU function support"
	depends on KPROBES && EXT4_FS
	default y
	help
	  Enable kernel-level root privileges on Android System.
	  Requires CONFIG_KPROBES for kernel hooking support.
	  Requires CONFIG_EXT4_FS for `ext4_unregister_sysfs`.
	  To compile as a module, choose M here: the
	  module will be called kinsu.

config KSU_DEBUG
	bool "KinSU debug mode"
	depends on KSU
	default n
	help
	  Enable KinSU debug mode.

config KPM
	bool "Enable KinSU KPM support"
	depends on KSU = y && ARM64
	default n
	select KALLSYMS
	select KALLSYMS_ALL
	help
	  Enable the KernelPatch Module (KPM) compatibility bridge used by
	  KernelPatch and the KinSU manager. The running kernel must also be
	  patched with the matching SukiSU KernelPatch image for standard KPM
	  modules to be loaded.

	  This feature executes third-party code in kernel context. Only enable
	  it for trusted KPM modules and tested kernel builds.

config KSU_DISABLE_MANAGER
	bool "Disable KinSU manager integration"
	depends on KSU
	default n
	help
	  Disable manager APK detection and manager-specific handling.
	  Root will be used in place of manager-only functionality.

config KSU_DISABLE_POLICY
	bool "Disable KinSU policy profiles"
	depends on KSU
	default n
	help
	  Disable per-app root/non-root profile customization.
	  Escalation will always use the default full root profile, and
	  non-root handling will follow the global umount policy only.

endmenu
```
